## NTP Timepiece/main/Kconfig.projbuild
```kconfig
menu "NTP Configuration"
	# Copied from https://esp32tutorials.com/esp32-web-server-esp-idf/
    config ESP_WIFI_SSID
        string "WiFi SSID"
        default "myRouterSSID"
        help
            SSID (network name) for the example to connect to.

	# Copied from https://esp32tutorials.com/esp32-web-server-esp-idf/
    config ESP_WIFI_PASSWORD
        string "WiFi Password"
        default "myRouterPassWd"
        help
            WiFi password (WPA or WPA2) for the example to use.

	# Copied from https://esp32tutorials.com/esp32-web-server-esp-idf/
    config ESP_MAXIMUM_RETRY
        int "Maximum retry"
        default 5
        help
            Set the Maximum retry to avoid station reconnecting to the AP unlimited when the AP is really inexistent.

    config SNTP_TIME_SERVER
        string "SNTP server name"
        default "pool.ntp.org"
        help
            Hostname of the main SNTP server.
            
    config NTP_SYNC_TIMEOUT_MS
        int "Milli seconds to sync with NTP server"
        default 10000
        help
            Milli seconds to wait to sync with NTP server.
    # Refer - https://github.com/nayarsystems/posix_tz_db/blob/master/zones.csv
    config TIME_ZONE
        string "Time Zone"
        default "CST6CDT"
        help
            Time zone of this clock.

    config LCD_SLAVE_ADDR
        hex "LCD Slave Address"
        default 0x27
        help
            This is the same as 0x4E>>1. It is hard wired in the device. Change this according to your device setup.

endmenu
```

## i2c_daisy_chain/main/Kconfig.projbuild
```kconfig
# menu for i2c Daicy Chain example
menu "i2c Daicy Chain Configuration"

    config PCF8574_SLAVE_ADDR
        hex "PCF8574 Slave Address"
        default 0x21
        help
            A0 jumper to ground on PCF8574 expander.

    config PCF8574_SLAVE_KPD_ADDRESS
        hex "PCF8574 Slave Keypad Address"
        default 0x20 
        help
            No jumper set for keypad on PCF8574 expander.

    config LCD_SLAVE_ADDR
        hex "LCD Slave Address"
        default 0x27
        help
            This is the same as 0x4E>>1. It is hard wired in the device. Change this according to your device setup.
            
    config ESP32_PIN_CONNECTED_TO_KEYPAD_INTERRUPT
        int "ESP32 PIN Connected to Keypad Interrupt"
        default 15
        help
            The interrupt pin 'INT' from PCF8574 is connected to GPIO15 of ESP32 (as it has a  WEAK INTERNAL PULLUP) to read the interrupt from that pin number.
            
endmenu
```
